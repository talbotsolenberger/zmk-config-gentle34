## boards/shields/gentle34/Kconfig.shield
```kconfig
# Copyright (c) 2020 The ZMK Contributors
# SPDX-License-Identifier: MIT

config SHIELD_GENTLE34_LEFT
    def_bool $(shields_list_contains,gentle34_left)

config SHIELD_GENTLE34_RIGHT
    def_bool $(shields_list_contains,gentle34_right)
```

## config/boards/shields/gentle34/Kconfig.defconfig
```kconfig
# Copyright (c) 2020 The ZMK Contributors
# SPDX-License-Identifier: MIT

if SHIELD_GENTLE34_LEFT

config ZMK_KEYBOARD_NAME
    default "gentle34"

config ZMK_SPLIT_ROLE_CENTRAL
    default y

endif

if SHIELD_GENTLE34_LEFT || SHIELD_GENTLE34_RIGHT

config ZMK_SPLIT
    default y

endif
```

## config/west.yml
```yaml
manifest:
  remotes:
    - name: zmkfirmware
      url-base: https://github.com/zmkfirmware
    # - name: talbotsolenberger
    #   url-base: https://github.com/talbotsolenberger
  projects:
    - name: zmk
      remote: zmkfirmware
      revision: v0.3 # version with working bluetooth
      # revision: main # version for most up to date features
      import: app/west.yml
    # - name: zmk-config-gentle34
    #   remote: talbotsolenberger
    #   revision: master
  self:
    path: config
```
